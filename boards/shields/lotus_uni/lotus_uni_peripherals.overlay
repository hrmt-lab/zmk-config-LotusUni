/*
 * LotusUni keyboard PCB used together with lotus_uni_dongle.
 *
 * This build is a split peripheral: it only forwards key positions to the
 * dongle. Host Link / Keylink Studio lives on the dongle, and /combos stays
 * enabled here because combos are resolved on the central.
 */

#include "lotus_uni.dtsi"
#include "lotus_uni_kscan.dtsi"
