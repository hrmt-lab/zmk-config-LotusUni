## config/west.yml
```yaml
manifest:
  remotes:
    - name: zmkfirmware
      url-base: https://github.com/zmkfirmware
    # - name: sekigon-gonnoc
    #   url-base: https://github.com/sekigon-gonnoc
    # - name: carrefinho
    #   url-base: https://github.com/carrefinho
    - name: hrmt-lab
      url-base: https://github.com/hrmt-lab
  projects:
    - name: zmk
      remote: zmkfirmware
      revision: main
      import: app/west.yml
#    - name: zmk-feature-non-lipo-battery-management
#      remote: sekigon-gonnoc
#      revision: main
    - name: prospector-zmk-module-ring
      remote: hrmt-lab
      revision: main
    - name: zmk-raw-hid
      remote: hrmt-lab
      revision: feat/keymap-advanced-behaviors
    - name: zmk-rawhid-app
      remote: hrmt-lab
      revision: feat/keymap-advanced-behaviors
  self:
    path: config
```
